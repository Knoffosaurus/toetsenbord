## keyboard-party/shields/zo_mooi/Kconfig.shield
```kconfig
config SHIELD_ZO_MOOI_LEFT
    def_bool $(shields_list_contains,zo_mooi_left)

config SHIELD_ZO_MOOI_RIGHT
    def_bool $(shields_list_contains,zo_mooi_right) 
```
