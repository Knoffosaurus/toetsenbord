#pragma once

#define MACRO(name, keys)                  
    name: name##_macro {
        label = #name;
        compatible = "zmk,behavior-macro";
        wait-ms = <1>;
        tap-ms = <1>;
        #binding-cells = <0>;
        bindings = <keys>;
    };

/ {
    macros {
        // Navigatie
        MACRO(tablf,  &kp LALT &kp LGUI &kp LEFT)   // Cmd + Option + Links
        MACRO(tabrt,  &kp LALT &kp LGUI &kp RIGHT)  // Cmd + Option + Rechts

        // Selectie shortcuts
        MACRO(sellf,  &kp LALT &kp LSHFT &kp LEFT)  // Option + Shift + Links
        MACRO(selrt,  &kp LALT &kp LSHFT &kp RIGHT) // Option + Shift + Rechts

        // Venster management
        MACRO(shtlf,  &kp LALT &kp UP)              // Option + Omhoog
        MACRO(shtrt,  &kp LALT &kp DOWN)            // Option + Omlaag
        
        // Systeem tools
        MACRO(emoji,  &kp LGUI &kp LCTRL &kp SPACE) // Emoji picker

        // Auto invullen
        MACRO(email,  &kp L &kp I &kp N &kp D &kp A &kp AT &kp N1 &kp N0 &kp K &kp B &kp DOT &kp N &kp L)
        MACRO(werk,   &kp N1 &kp N0 &kp LS(K) &kp LS(B))
        MACRO(tel,    &kp N0 &kp N2 &kp N4 &kp N6 &kp N6 &kp N9 &kp N0 &kp N5 &kp N1 &kp N8)
        MACRO(info,   &kp I &kp N &kp F &kp O &kp AT &kp N1 &kp N0 &kp K &kp B &kp DOT &kp N &kp L)
        MACRO(vasim,  &kp LS(V) &kp A &kp S &kp I &kp M)
        MACRO(mail,   &kp AT &kp N1 &kp N0 &kp K &kp B &kp DOT &kp N &kp L)
        MACRO(pijl,   &kp MINUS &kp GT)
    };
}; 