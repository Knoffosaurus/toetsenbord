#include <behaviors.dtsi>
#include <dt-bindings/zmk/keys.h>
#include <dt-bindings/zmk/bt.h>
#include <dt-bindings/zmk/outputs.h>
#include <behaviors/num_word.dtsi> // Requires auto-layer module.

#include "key_labels.dtsi"

// Layer definitions
#define DEF     0
#define NAV     1
#define NUM     2
#define MOUSE   3 

#define XXX &none
#define ___ &trans

#define QUICK_TAP_MS 175

&sk {
  release-after-ms = <900>;
  quick-release;
};

&sl { // Allow sticky mods to chord across sticky layers.
  ignore-modifiers;
};

&lt {
  flavor = "balanced";
  tapping-term-ms = <200>;
  quick-tap-ms = <QUICK_TAP_MS>;
};

/* Homerow mods */

#define KEYS_L LB0 LB1 LB2 LB3 LB4 LB5 LM0 LM1 LM2 LM3 LM4 LM5 LO0 LO1 LO2 LO3 LO4 LO5 // Linkerhand
#define KEYS_R RB0 RB1 RB2 RB3 RB4 RB5 RM0 RM1 RM2 RM3 RM4 RM5 RO0 RO1 RO2 RO3 RO4 RO5 // Rechterhand
#define THUMBS LD4 LD3 LD2 LD1 LD0 RD0 RD1 RD2 RD3 RD4                                 // Duimen

#define HOMEROW(NAME, HOLD, TAP, TRIGGER_POS)                                 \
  ZMK_HOLD_TAP(NAME, bindings = <HOLD>, <TAP>; flavor = "balanced";            \
               tapping-term-ms = <280>; quick-tap-ms = <QUICK_TAP_MS>;         \
               require-prior-idle-ms = <150>; hold-trigger-on-release;         \
               hold-trigger-key-positions = <TRIGGER_POS>;)

MAKE_HRM(hml, &kp, &kp, KEYS_R THUMBS) // Linkerhand homerow
MAKE_HRM(hmr, &kp, &kp, KEYS_L THUMBS) // Rechterhand homerow

// Hack: Make HRM combos tap-only
#define ZMK_COMBO_8(NAME, TAP, POS, LAYERS, COMBO_MS, IDLE_MS, HOLD, SIDE)     \
  MAKE_HRM(hm_combo_##NAME, &kp, TAP, SIDE THUMBS)                             \
  ZMK_COMBO_6(NAME, &hm_combo_##NAME HOLD 0, POS, LAYERS, COMBO_MS, IDLE_MS)

#include "combos.dtsi"
#include "mouse.dtsi"

// Trigger tap-action on all interrupts.
#define MT_CORE                                                                \
  flavor = "tap-preferred";                                                    \
  tapping-term-ms = <220>;                                                     \
  quick-tap-ms = <220>;                                                        \
  hold-trigger-key-positions = <0>;

&mt { MT_CORE };

ZMK_HOLD_TAP(mt_home, bindings = <&masked_home>, <&kp>; MT_CORE)
ZMK_HOLD_TAP(mt_end, bindings = <&masked_end>, <&kp>; MT_CORE)

#define NAV_LEFT  &mt_home 0   LEFT  // Tap: left  | Long-tap: start of line.
#define NAV_RIGHT &mt_end 0    RIGHT // Tap: right | Long-tap: end   of line.
#define NAV_UP    &mt LC(HOME) UP    // Tap: up    | Long-tap: start of doc.
#define NAV_DOWN  &mt LC(END)  DOWN  // Tap: down  | Long-tap: end   of doc.
#define NAV_BSPC  &mt LC(BSPC) BSPC  // Tap: bspc  | Long-tap: delete word bwd.
#define NAV_DEL   &mt LC(DEL)  DEL   // Tap: del   | Long-tap: delete word fwd.

// Mask CTRL on left/right hold to avoid accidental jumps to start/end of doc.
#define MASK_MODS(NAME, MODS, BINDING)                                         \
  ZMK_MOD_MORPH(NAME, bindings = <BINDING>, <BINDING>; mods = <MODS>;)

MASK_MODS(masked_home, (MOD_LCTL), &kp HOME)
MASK_MODS(masked_end,  (MOD_LCTL), &kp END)

// Tap: num-word | double-tap: sticky num-layer | Hold: num-layer.
#define SMART_NUM &smart_num NUM 0
ZMK_HOLD_TAP(smart_num, bindings = <&mo>, <&num_dance>; flavor = "balanced";
             tapping-term-ms = <200>; quick-tap-ms = <QUICK_TAP_MS>;)
ZMK_TAP_DANCE(num_dance, bindings = <&num_word NUM>, <&sl NUM>;
              tapping-term-ms = <200>;)

// Define mod-morph with a *single* mod trigger for less repetition.
#define SIMPLE_MORPH(NAME, MOD, BINDING1, BINDING2)                            \
  ZMK_MOD_MORPH(NAME, mods = <(MOD_L##MOD | MOD_R##MOD)>;                      \
                bindings = <BINDING1>, <BINDING2>;)

// Tap: comma | Shift + tap: "(" | Ctrl + shift + tap: <.
SIMPLE_MORPH(comma_morph, SFT, &kp COMMA, &comma_inner_morph)
SIMPLE_MORPH(comma_inner_morph, CTL, &kp LPAR, &kp LESS_THAN)

// Tap: dot | Shift + tap: ")" | Ctrl + shift + tap: >.
SIMPLE_MORPH(dot_morph, SFT, &kp DOT, &dot_inner_morph)
SIMPLE_MORPH(dot_inner_morph, CTL, &kp RPAR, &kp GREATER_THAN)

// Tap: qmark | Shift + tap: excl.
SIMPLE_MORPH(qexcl, SFT, &kp QMARK, &kp EXCL)

#ifndef ZMK_BASE_LAYER
  #define ZMK_BASE_LAYER(name, LB, RB, LM, RM, LO, MD, RO, LD, RD)                 \
      ZMK_LAYER(name, LB RB LM RM LO MD RO LD RD)
#endif

ZMK_BASE_LAYER(colemak,
//╭─────────────┬─────────────┬─────────────┬─────────────┬─────────────┬─────────────╮                                                         ╭─────────────┬─────────────┬─────────────┬─────────────┬─────────────┬─────────────╮
    &kp TAB       &kp Q         &kp W         &kp F         &kp P         &kp B       ,                                                           &kp Y         &kp L         &kp U         &kp J         &kp SEMI      &kp BSPC    ,
//├─────────────┼─────────────┼─────────────┼─────────────┼─────────────┼─────────────┤                                                         ├─────────────┼─────────────┼─────────────┼─────────────┼─────────────┤─────────────┤
    &kp CAPS      &hml LSHFT A  &hml LCTRL R  &hml LALT S   &hml LCMD T   &kp G       ,                                                           &kp K         &hmr LCMD N   &hmr LALT E   &hmr LCTR I   &hmr RSHFT O  &kp ENTER   ,
//├─────────────┼─────────────┼─────────────┼─────────────┼─────────────┼─────────────┼─────────────╮                             ╭─────────────┼─────────────┼─────────────┼─────────────┼─────────────┼─────────────┼─────────────┤
    XXX           &kp Z         &kp X         &kp C         &kp D         &kp V       , &kp ESC                                     XXX         , &kp M         &kp H         &comma_morph  &dot_morph    &qexcl        &kp SQT     ,
//╰─────────────┼─────────────┴─────────────┴─────────────┼─────────────┼─────────────┼─────────────┼─────────────╮ ╭─────────────┼─────────────┼─────────────┼─────────────┼─────────────┴─────────────┴─────────────┴─────────────╯
                                                            &kp LALT      &kp LCMD      &lt NAV BSPC  &mo MOUSE   ,   XXX           &lt NUM SPACE &kp DEL       &kp LCTRL
//                                                        ╰─────────────┴─────────────┴─────────────┴─────────────╯ ╰─────────────┴─────────────┴─────────────┴─────────────╯
//                                                          &lt_spc NAV 0 &lt FN RET    SMART_NUM     &smart_shft 
)

ZMK_BASE_LAYER(Nav,
//╭─────────────┬─────────────┬─────────────┬─────────────┬─────────────┬─────────────╮                                                         ╭─────────────┬─────────────┬─────────────┬─────────────┬─────────────┬─────────────╮
    ___           ___           ___           ___           ___           ___         ,                                                           ___           NAV_BSPC      &kp PG_UP     NAV_DEL       ___           ___         ,
//├─────────────┼─────────────┼─────────────┼─────────────┼─────────────┼─────────────┤                                                         ├─────────────┼─────────────┼─────────────┼─────────────┼─────────────┤─────────────┤
    ___           &sk LGUI      &sk LALT      &sk LSHFT     &sk LCTRL     ___         ,                                                           &kp PG_DN     NAV_LEFT      NAV_UP        NAV_RIGHT     &kp RET       ___         ,   
//├─────────────┼─────────────┼─────────────┼─────────────┼─────────────┼─────────────┼─────────────╮                             ╭─────────────┼─────────────┼─────────────┼─────────────┼─────────────┼─────────────┼─────────────┤
    ___           ___           ___           ___           ___           ___         , ___                                         ___         , ___           &kp wrdlf     NAV_DOWN      &kp wrdrt     ___           ___         ,
//╰─────────────┼─────────────┴─────────────┴─────────────┼─────────────┼─────────────┼─────────────┼─────────────╮ ╭─────────────┼─────────────┼─────────────┼─────────────┼─────────────┴─────────────┴─────────────┴─────────────╯
                                                            ___           ___           ___           ___         ,   &kp tablf     &kp tabrt     &kp shtlf     kp shtrt
//                                                        ╰─────────────┴─────────────┴─────────────┴─────────────╯ ╰─────────────┴─────────────┴─────────────┴─────────────╯
)

ZMK_BASE_LAYER(Num,
//╭─────────────┬─────────────┬─────────────┬─────────────┬─────────────┬─────────────╮                                                         ╭─────────────┬─────────────┬─────────────┬─────────────┬─────────────┬─────────────╮
    ___           ___           ___           ___           ___           ___         ,                                                           &kp PLUS      &kp N7        &kp N8        &kp N9        &kp ASTRK     &kp BSPC    ,         
//├─────────────┼─────────────┼─────────────┼─────────────┼─────────────┼─────────────┤                                                         ├─────────────┼─────────────┼─────────────┼─────────────┼─────────────┤─────────────┤
    ___           &kp Undo      &kp Cut       &kp Copy      &kp Paste     &kp Redo    ,                                                           &kp MINUS     &kp N4        &kp N5        &kp N6        &kp SLASH     &kp ENTER   ,
//├─────────────┼─────────────┼─────────────┼─────────────┼─────────────┼─────────────┼─────────────╮                             ╭─────────────┼─────────────┼─────────────┼─────────────┼─────────────┼─────────────┼─────────────┤
    ___           ___           ___           ___           ___           ___         , ___                                         ___         , &kp EQUAL     &kp N1        &kp N2        &kp N3        &kp DOT       &kp COMMA   ,
//╰─────────────┼─────────────┴─────────────┴─────────────┼─────────────┼─────────────┼─────────────┼─────────────╮ ╭─────────────┼─────────────┼─────────────┼─────────────┼─────────────┴─────────────┴─────────────┴─────────────╯
                                                            ___           ___           ___           ___         ,   ___           ___           &kp COLON     &kp N0
//                                                        ╰─────────────┴─────────────┴─────────────┴─────────────╯ ╰─────────────┴─────────────┴─────────────┴─────────────╯
)

ZMK_BASE_LAYER(Mouse,
//╭─────────────┬─────────────┬─────────────┬─────────────┬─────────────┬─────────────╮                                                         ╭─────────────┬─────────────┬─────────────┬─────────────┬─────────────┬─────────────╮
    ___           &info         &email        &tel          &pijl         &bt BT_CLR  ,                                                           ___           &kp PG_UP     &sht_u        &kp PG_DN     ___           ___         ,
//├─────────────┼─────────────┼─────────────┼─────────────┼─────────────┼─────────────┤                                                         ├─────────────┼─────────────┼─────────────┼─────────────┼─────────────┤─────────────┤
    ___           &vasim        &werk         &mail         &kp Paste     ___         ,                                                           ___           &mht_l        &mht_u        &mht_r        ___           ___         ,
//├─────────────┼─────────────┼─────────────┼─────────────┼─────────────┼─────────────┼─────────────╮                             ╭─────────────┼─────────────┼─────────────┼─────────────┼─────────────┼─────────────┼─────────────┤
    ___           ___           ___           ___           ___           ___         , ___                                         ___         , ___           ___           &mht_d        &sht_d        ___           ___         ,
//╰─────────────┼─────────────┴─────────────┴─────────────┼─────────────┼─────────────┼─────────────┼─────────────╮ ╭─────────────┼─────────────┼─────────────┼─────────────┼─────────────┴─────────────┴─────────────┴─────────────╯
                                                            ___           ___           ___           ___         ,   &kp prev      &kp next      &mkp MB1      &mkp MB2
//                                                        ╰─────────────┴─────────────┴─────────────┴─────────────╯ ╰─────────────┴─────────────┴─────────────┴─────────────╯
)
